## configs/odroid_xu4_defconfig
```kconfig
# Arch
BR2_arm=y
BR2_cortex_a15_a7=y
BR2_ARM_FPU_NEON_VFPV4=y
BR2_ARM_INSTRUCTIONS_ARM=y

BR2_TOOLCHAIN_EXTERNAL=y
# BR2_TOOLCHAIN_EXTERNAL_LINARO_ARM=y
BR2_USE_MMU=y

# System
BR2_ROOTFS_POST_IMAGE_SCRIPT="board/hardkernel/odroidxu4/post-image.sh"

# Filesystem images
BR2_TARGET_ROOTFS_EXT2=y
BR2_TARGET_ROOTFS_EXT2_4=y
BR2_TARGET_ROOTFS_EXT2_GEN=4
BR2_TARGET_ROOTFS_EXT2_REV=1
BR2_TARGET_ROOTFS_EXT2_LABEL=""
BR2_TARGET_ROOTFS_EXT2_INODES=0
BR2_TARGET_ROOTFS_EXT2_SIZE="2G"
BR2_TARGET_ROOTFS_EXT2_RESBLKS=5
BR2_TARGET_ROOTFS_EXT2_MKFS_OPTIONS="-O ^64bit"
BR2_TARGET_ROOTFS_EXT2_NONE=y

# Kernel
BR2_LINUX_KERNEL=y
BR2_LINUX_KERNEL_CUSTOM_GIT=y
BR2_LINUX_KERNEL_CUSTOM_REPO_URL="https://github.com/hardkernel/linux.git"
BR2_LINUX_KERNEL_CUSTOM_REPO_VERSION="odroidxu4-4.9.y"
BR2_LINUX_KERNEL_VERSION="odroidxu4-4.9.58"
BR2_LINUX_KERNEL_USE_DEFCONFIG=y
BR2_LINUX_KERNEL_DEFCONFIG="odroidxu4"
R2_LINUX_KERNEL_DTS_SUPPORT=y
BR2_LINUX_KERNEL_USE_INTREE_DTS=y
BR2_LINUX_KERNEL_INTREE_DTS_NAME="exynos5422-odroidxu4"
BR2_LINUX_KERNEL_ZIMAGE=y
BR2_LINUX_KERNEL_GZIP=y

BR2_TARGET_UBOOT=y
BR2_TARGET_UBOOT_BUILD_SYSTEM_KCONFIG=y
BR2_TARGET_UBOOT_USE_DEFCONFIG=y
BR2_TARGET_UBOOT_BOARD_DEFCONFIG="odroid-xu4"
BR2_TARGET_UBOOT_CUSTOM_GIT=y
BR2_TARGET_UBOOT_CUSTOM_REPO_URL="https://github.com/hardkernel/u-boot"
BR2_TARGET_UBOOT_CUSTOM_REPO_VERSION="odroidxu4-v2017.05"
BR2_TARGET_UBOOT_VERSION="odroidxu4-v2017.05"
BR2_TARGET_UBOOT_NEEDS_DTC=y

BR2_TARGET_UBOOT_FORMAT_BIN=y
BR2_TARGET_UBOOT_FORMAT_CUSTOM=y
BR2_TARGET_UBOOT_FORMAT_CUSTOM_NAME="u-boot-dtb.bin"

# WiFi
BR2_PACKAGE_RTL8821AU=y

#BR2_ARCH="arm"
#BR2_ENDIAN="LITTLE"
#BR2_GCC_TARGET_ABI="aapcs-linux"
#BR2_GCC_TARGET_CPU="cortex-a15.cortex-a7"
#BR2_GCC_TARGET_FPU="vfpv4-d16"
#BR2_GCC_TARGET_FLOAT_ABI="hard"
#BR2_GCC_TARGET_MODE="arm"
#BR2_BINFMT_SUPPORTS_SHARED=y
#BR2_READELF_ARCH_NAME="ARM"
#BR2_BINFMT_ELF=y
#BR2_ARM_CPU_HAS_NEON=y
#BR2_ARM_CPU_HAS_VFPV2=y
#BR2_ARM_CPU_HAS_VFPV3=y
#BR2_ARM_CPU_HAS_VFPV4=y
#BR2_ARM_CPU_HAS_ARM=y
#BR2_ARM_CPU_HAS_THUMB2=y
#BR2_ARM_CPU_ARMV7A=y
#BR2_WGET="wget --passive-ftp -nd -t 3"
#BR2_SVN="svn"
#BR2_BZR="bzr"
#BR2_GIT="git"
#BR2_CVS="cvs"
#BR2_LOCALFILES="cp"
#BR2_SCP="scp"
#BR2_SSH="ssh"
#BR2_HG="hg"
#BR2_ZCAT="gzip -d -c"
#BR2_BZCAT="bzcat"
#BR2_XZCAT="xzcat"
#BR2_LZCAT="lzip -d -c"
#BR2_TAR_OPTIONS=""
#BR2_DEFCONFIG="$(CONFIG_DIR)/defconfig"
#BR2_DL_DIR="$(TOPDIR)/dl"
#BR2_HOST_DIR="$(BASE_DIR)/host"

#
# Mirrors and Download locations
#
#BR2_PRIMARY_SITE=""
#BR2_BACKUP_SITE="http://sources.buildroot.net"
#BR2_KERNEL_MIRROR="https://cdn.kernel.org/pub"
#BR2_GNU_MIRROR="http://ftpmirror.gnu.org"
#BR2_LUAROCKS_MIRROR="http://rocks.moonscript.org"
#BR2_CPAN_MIRROR="http://cpan.metacpan.org"
#BR2_JLEVEL=0
#BR2_CCACHE=y
#BR2_CCACHE_DIR="$(HOME)/.buildroot-ccache"
#BR2_CCACHE_INITIAL_SETUP=""
#BR2_CCACHE_USE_BASEDIR=y
# BR2_ENABLE_DEBUG is not set
# BR2_STRIP_strip is not set
# BR2_OPTIMIZE_0 is not set
# BR2_OPTIMIZE_1 is not set
# BR2_OPTIMIZE_2 is not set
# BR2_OPTIMIZE_3 is not set
# BR2_OPTIMIZE_G is not set
#BR2_OPTIMIZE_S=y

#
# Stack Smashing Protection needs a toolchain w/ SSP
#
# BR2_STATIC_LIBS is not set
#BR2_SHARED_LIBS=y
# BR2_SHARED_STATIC_LIBS is not set
#BR2_PACKAGE_OVERRIDE_FILE="$(CONFIG_DIR)/local.mk"
#BR2_GLOBAL_PATCH_DIR=""

#
# Advanced
#
#BR2_COMPILER_PARANOID_UNSAFE_PATH=y
# BR2_REPRODUCIBLE is not set

#
# Toolchain
#
#BR2_TOOLCHAIN=y
#BR2_TOOLCHAIN_USES_UCLIBC=y
#BR2_TOOLCHAIN_BUILDROOT=y

#
# Toolchain Buildroot Options
#
#BR2_TOOLCHAIN_BUILDROOT_VENDOR="buildroot"
#BR2_TOOLCHAIN_BUILDROOT_UCLIBC=y
# BR2_TOOLCHAIN_BUILDROOT_GLIBC is not set
# BR2_TOOLCHAIN_BUILDROOT_MUSL is not set
#BR2_TOOLCHAIN_BUILDROOT_LIBC="uclibc"

#
# Kernel Header Options
#
#BR2_KERNEL_HEADERS_AS_KERNEL=y
# BR2_KERNEL_HEADERS_3_2 is not set
# BR2_KERNEL_HEADERS_3_4 is not set
# BR2_KERNEL_HEADERS_3_10 is not set
# BR2_KERNEL_HEADERS_3_12 is not set
# BR2_KERNEL_HEADERS_4_1 is not set
# BR2_KERNEL_HEADERS_4_4 is not set
# BR2_KERNEL_HEADERS_4_9 is not set
# BR2_KERNEL_HEADERS_4_10 is not set
# BR2_KERNEL_HEADERS_4_11 is not set
# BR2_KERNEL_HEADERS_4_12 is not set
# BR2_KERNEL_HEADERS_4_13 is not set
# BR2_KERNEL_HEADERS_VERSION is not set
#BR2_PACKAGE_HOST_LINUX_HEADERS_CUSTOM_4_13=y
# BR2_PACKAGE_HOST_LINUX_HEADERS_CUSTOM_4_12 is not set
# BR2_PACKAGE_HOST_LINUX_HEADERS_CUSTOM_4_11 is not set
# BR2_PACKAGE_HOST_LINUX_HEADERS_CUSTOM_4_10 is not set
# BR2_PACKAGE_HOST_LINUX_HEADERS_CUSTOM_4_9 is not set
# BR2_PACKAGE_HOST_LINUX_HEADERS_CUSTOM_4_8 is not set
# BR2_PACKAGE_HOST_LINUX_HEADERS_CUSTOM_4_7 is not set
# BR2_PACKAGE_HOST_LINUX_HEADERS_CUSTOM_4_6 is not set
# BR2_PACKAGE_HOST_LINUX_HEADERS_CUSTOM_4_5 is not set
# BR2_PACKAGE_HOST_LINUX_HEADERS_CUSTOM_4_4 is not set
# BR2_PACKAGE_HOST_LINUX_HEADERS_CUSTOM_4_3 is not set
# BR2_PACKAGE_HOST_LINUX_HEADERS_CUSTOM_4_2 is not set
# BR2_PACKAGE_HOST_LINUX_HEADERS_CUSTOM_4_1 is not set
# BR2_PACKAGE_HOST_LINUX_HEADERS_CUSTOM_4_0 is not set
# BR2_PACKAGE_HOST_LINUX_HEADERS_CUSTOM_3_19 is not set
# BR2_PACKAGE_HOST_LINUX_HEADERS_CUSTOM_3_18 is not set
# BR2_PACKAGE_HOST_LINUX_HEADERS_CUSTOM_3_17 is not set
# BR2_PACKAGE_HOST_LINUX_HEADERS_CUSTOM_3_16 is not set
# BR2_PACKAGE_HOST_LINUX_HEADERS_CUSTOM_3_15 is not set
# BR2_PACKAGE_HOST_LINUX_HEADERS_CUSTOM_3_14 is not set
# BR2_PACKAGE_HOST_LINUX_HEADERS_CUSTOM_3_13 is not set
# BR2_PACKAGE_HOST_LINUX_HEADERS_CUSTOM_3_12 is not set
# BR2_PACKAGE_HOST_LINUX_HEADERS_CUSTOM_3_11 is not set
# BR2_PACKAGE_HOST_LINUX_HEADERS_CUSTOM_3_10 is not set
# BR2_PACKAGE_HOST_LINUX_HEADERS_CUSTOM_3_9 is not set
# BR2_PACKAGE_HOST_LINUX_HEADERS_CUSTOM_3_8 is not set
# BR2_PACKAGE_HOST_LINUX_HEADERS_CUSTOM_3_7 is not set
# BR2_PACKAGE_HOST_LINUX_HEADERS_CUSTOM_3_6 is not set
# BR2_PACKAGE_HOST_LINUX_HEADERS_CUSTOM_3_5 is not set
# BR2_PACKAGE_HOST_LINUX_HEADERS_CUSTOM_3_4 is not set
# BR2_PACKAGE_HOST_LINUX_HEADERS_CUSTOM_3_3 is not set
# BR2_PACKAGE_HOST_LINUX_HEADERS_CUSTOM_3_2 is not set
# BR2_PACKAGE_HOST_LINUX_HEADERS_CUSTOM_3_1 is not set
# BR2_PACKAGE_HOST_LINUX_HEADERS_CUSTOM_3_0 is not set
# BR2_PACKAGE_HOST_LINUX_HEADERS_CUSTOM_REALLY_OLD is not set
#BR2_PACKAGE_LINUX_HEADERS=y

#
# uClibc Options
#
#BR2_PACKAGE_UCLIBC=y
#BR2_UCLIBC_CONFIG="package/uclibc/uClibc-ng.config"
#BR2_UCLIBC_CONFIG_FRAGMENT_FILES=""
# BR2_TOOLCHAIN_BUILDROOT_WCHAR is not set
# BR2_TOOLCHAIN_BUILDROOT_LOCALE is not set
#BR2_PTHREADS_NATIVE=y
# BR2_PTHREADS is not set
# BR2_PTHREADS_NONE is not set
# BR2_PTHREAD_DEBUG is not set
# BR2_TOOLCHAIN_BUILDROOT_USE_SSP is not set
#BR2_UCLIBC_INSTALL_UTILS=y
#BR2_UCLIBC_TARGET_ARCH="arm"

#
# Binutils Options
#
# BR2_BINUTILS_VERSION_2_27_X is not set
#BR2_BINUTILS_VERSION_2_28_X=y
# BR2_BINUTILS_VERSION_2_29_X is not set
#BR2_BINUTILS_VERSION="2.28.1"
#BR2_BINUTILS_EXTRA_CONFIG_OPTIONS=""

#
# GCC Options
#
# BR2_GCC_VERSION_4_9_X is not set
# BR2_GCC_VERSION_5_X is not set
#BR2_GCC_VERSION_6_X=y
# BR2_GCC_VERSION_7_X is not set
#BR2_GCC_ARCH_HAS_CONFIGURABLE_DEFAULTS=y
#BR2_GCC_SUPPORTS_FINEGRAINEDMTUNE=y
#BR2_GCC_VERSION="6.4.0"
#BR2_EXTRA_GCC_CONFIG_OPTIONS=""
#BR2_TOOLCHAIN_BUILDROOT_CXX=y
# BR2_TOOLCHAIN_BUILDROOT_FORTRAN is not set
# BR2_GCC_ENABLE_LTO is not set
# BR2_GCC_ENABLE_OPENMP is not set
# BR2_GCC_ENABLE_GRAPHITE is not set

#
# Host GDB Options
#
# BR2_PACKAGE_HOST_GDB is not set

#
# Toolchain Generic Options
#
#BR2_INSTALL_LIBSTDCPP=y
#BR2_TOOLCHAIN_HAS_THREADS=y
#BR2_TOOLCHAIN_HAS_THREADS_NPTL=y
#BR2_TOOLCHAIN_HAS_SHADOW_PASSWORDS=y
#BR2_TOOLCHAIN_SUPPORTS_PIE=y
#BR2_TARGET_OPTIMIZATION=""
#BR2_TARGET_LDFLAGS=""
# BR2_ECLIPSE_REGISTER is not set
#BR2_TOOLCHAIN_HEADERS_AT_LEAST_3_0=y
#BR2_TOOLCHAIN_HEADERS_AT_LEAST_3_1=y
#BR2_TOOLCHAIN_HEADERS_AT_LEAST_3_2=y
#BR2_TOOLCHAIN_HEADERS_AT_LEAST_3_3=y
#BR2_TOOLCHAIN_HEADERS_AT_LEAST_3_4=y
#BR2_TOOLCHAIN_HEADERS_AT_LEAST_3_5=y
#BR2_TOOLCHAIN_HEADERS_AT_LEAST_3_6=y
#BR2_TOOLCHAIN_HEADERS_AT_LEAST_3_7=y
#BR2_TOOLCHAIN_HEADERS_AT_LEAST_3_8=y
#BR2_TOOLCHAIN_HEADERS_AT_LEAST_3_9=y
#BR2_TOOLCHAIN_HEADERS_AT_LEAST_3_10=y
#BR2_TOOLCHAIN_HEADERS_AT_LEAST_3_11=y
#BR2_TOOLCHAIN_HEADERS_AT_LEAST_3_12=y
#BR2_TOOLCHAIN_HEADERS_AT_LEAST_3_13=y
#BR2_TOOLCHAIN_HEADERS_AT_LEAST_3_14=y
#BR2_TOOLCHAIN_HEADERS_AT_LEAST_3_15=y
#BR2_TOOLCHAIN_HEADERS_AT_LEAST_3_16=y
#BR2_TOOLCHAIN_HEADERS_AT_LEAST_3_17=y
#BR2_TOOLCHAIN_HEADERS_AT_LEAST_3_18=y
#BR2_TOOLCHAIN_HEADERS_AT_LEAST_3_19=y
#BR2_TOOLCHAIN_HEADERS_AT_LEAST_4_0=y
#BR2_TOOLCHAIN_HEADERS_AT_LEAST_4_1=y
#BR2_TOOLCHAIN_HEADERS_AT_LEAST_4_2=y
#BR2_TOOLCHAIN_HEADERS_AT_LEAST_4_3=y
#BR2_TOOLCHAIN_HEADERS_AT_LEAST_4_4=y
#BR2_TOOLCHAIN_HEADERS_AT_LEAST_4_5=y
#BR2_TOOLCHAIN_HEADERS_AT_LEAST_4_6=y
#BR2_TOOLCHAIN_HEADERS_AT_LEAST_4_7=y
#BR2_TOOLCHAIN_HEADERS_AT_LEAST_4_8=y
#BR2_TOOLCHAIN_HEADERS_AT_LEAST_4_9=y
#BR2_TOOLCHAIN_HEADERS_AT_LEAST_4_10=y
#BR2_TOOLCHAIN_HEADERS_AT_LEAST_4_11=y
#BR2_TOOLCHAIN_HEADERS_AT_LEAST_4_12=y
#BR2_TOOLCHAIN_HEADERS_AT_LEAST_4_13=y
#BR2_TOOLCHAIN_HEADERS_AT_LEAST="4.13"
#BR2_TOOLCHAIN_GCC_AT_LEAST_4_3=y
#BR2_TOOLCHAIN_GCC_AT_LEAST_4_4=y
#BR2_TOOLCHAIN_GCC_AT_LEAST_4_5=y
#BR2_TOOLCHAIN_GCC_AT_LEAST_4_6=y
#BR2_TOOLCHAIN_GCC_AT_LEAST_4_7=y
#BR2_TOOLCHAIN_GCC_AT_LEAST_4_8=y
#BR2_TOOLCHAIN_GCC_AT_LEAST_4_9=y
#BR2_TOOLCHAIN_GCC_AT_LEAST_5=y
#BR2_TOOLCHAIN_GCC_AT_LEAST_6=y
#BR2_TOOLCHAIN_GCC_AT_LEAST="6"
#BR2_TOOLCHAIN_HAS_MNAN_OPTION=y
#BR2_TOOLCHAIN_HAS_MFPXX_OPTION=y
#BR2_TOOLCHAIN_HAS_SYNC_1=y
#BR2_TOOLCHAIN_HAS_SYNC_2=y
#BR2_TOOLCHAIN_HAS_SYNC_4=y
#BR2_TOOLCHAIN_ARM_HAS_SYNC_8=y
#BR2_TOOLCHAIN_HAS_SYNC_8=y
#BR2_TOOLCHAIN_HAS_LIBATOMIC=y
#BR2_TOOLCHAIN_HAS_ATOMIC=y

#
# System configuration
#
#BR2_ROOTFS_SKELETON_DEFAULT=y
# BR2_ROOTFS_SKELETON_CUSTOM is not set
# BR2_ROOTFS_MERGED_USR is not set
#BR2_TARGET_GENERIC_HOSTNAME="buildroot"
#BR2_TARGET_GENERIC_ISSUE="Welcome to Buildroot"
#BR2_TARGET_GENERIC_PASSWD_MD5=y
# BR2_TARGET_GENERIC_PASSWD_SHA256 is not set
# BR2_TARGET_GENERIC_PASSWD_SHA512 is not set
#BR2_TARGET_GENERIC_PASSWD_METHOD="md5"
#BR2_INIT_BUSYBOX=y
# BR2_INIT_SYSV is not set

#
# systemd needs a glibc toolchain, headers >= 3.10
#
# BR2_INIT_NONE is not set
# BR2_ROOTFS_DEVICE_CREATION_STATIC is not set
#BR2_ROOTFS_DEVICE_CREATION_DYNAMIC_DEVTMPFS=y
# BR2_ROOTFS_DEVICE_CREATION_DYNAMIC_MDEV is not set

#
# eudev needs a toolchain w/ wchar, dynamic library
#
#BR2_ROOTFS_DEVICE_TABLE="system/device_table.txt"
# BR2_ROOTFS_DEVICE_TABLE_SUPPORTS_EXTENDED_ATTRIBUTES is not set
#BR2_TARGET_ENABLE_ROOT_LOGIN=y
#BR2_TARGET_GENERIC_ROOT_PASSWD=""
#BR2_SYSTEM_BIN_SH_BUSYBOX=y

#
# bash, dash, mksh, zsh need BR2_PACKAGE_BUSYBOX_SHOW_OTHERS
#
# BR2_SYSTEM_BIN_SH_NONE is not set
#BR2_TARGET_GENERIC_GETTY=y
#BR2_TARGET_GENERIC_GETTY_PORT="console"
#BR2_TARGET_GENERIC_GETTY_BAUDRATE_KEEP=y
# BR2_TARGET_GENERIC_GETTY_BAUDRATE_9600 is not set
# BR2_TARGET_GENERIC_GETTY_BAUDRATE_19200 is not set
# BR2_TARGET_GENERIC_GETTY_BAUDRATE_38400 is not set
# BR2_TARGET_GENERIC_GETTY_BAUDRATE_57600 is not set
# BR2_TARGET_GENERIC_GETTY_BAUDRATE_115200 is not set
#BR2_TARGET_GENERIC_GETTY_BAUDRATE="0"
#BR2_TARGET_GENERIC_GETTY_TERM="vt100"
#BR2_TARGET_GENERIC_GETTY_OPTIONS=""
#BR2_TARGET_GENERIC_REMOUNT_ROOTFS_RW=y
#BR2_SYSTEM_DHCP=""
#BR2_ENABLE_LOCALE_PURGE=y
#BR2_ENABLE_LOCALE_WHITELIST="C en_US"

#
# NLS support needs a toolchain w/ wchar, dynamic library
#
# BR2_TARGET_TZ_INFO is not set
#BR2_ROOTFS_USERS_TABLES=""
#BR2_ROOTFS_OVERLAY=""
#BR2_ROOTFS_POST_BUILD_SCRIPT=""
#BR2_ROOTFS_POST_FAKEROOT_SCRIPT=""
#BR2_ROOTFS_POST_IMAGE_SCRIPT=""

#
# Kernel
#
#BR2_PACKAGE_BUSYBOX=y
#BR2_PACKAGE_BUSYBOX_CONFIG="package/busybox/busybox.config"
#BR2_PACKAGE_BUSYBOX_CONFIG_FRAGMENT_FILES=""
#BR2_PACKAGE_SKELETON=y
#BR2_PACKAGE_HAS_SKELETON=y
#BR2_PACKAGE_PROVIDES_SKELETON="skeleton-init-sysv"
#BR2_PACKAGE_SKELETON_INIT_COMMON=y
#BR2_PACKAGE_SKELETON_INIT_SYSV=y
#BR2_PACKAGE_FFMPEG_ARCH_SUPPORTS=y
#BR2_PACKAGE_KODI_ARCH_SUPPORTS=y
#BR2_PACKAGE_PULSEAUDIO_HAS_ATOMIC=y
#BR2_PACKAGE_GDB_ARCH_SUPPORTS=y
#BR2_PACKAGE_GOOGLE_BREAKPAD_ARCH_SUPPORTS=y
#BR2_PACKAGE_KVM_UNIT_TESTS_ARCH_SUPPORTS=y
#BR2_PACKAGE_LTP_TESTSUITE_ARCH_SUPPORTS=y
#BR2_PACKAGE_OPROFILE_ARCH_SUPPORTS=y
#BR2_PACKAGE_TRINITY_ARCH_SUPPORTS=y
#BR2_PACKAGE_VALGRIND_ARCH_SUPPORTS=y
#BR2_PACKAGE_CMAKE_ARCH_SUPPORTS=y
#BR2_PACKAGE_QT5_JSCORE_AVAILABLE=y
#BR2_PACKAGE_ERLANG_ARCH_SUPPORTS=y
#BR2_PACKAGE_GAUCHE_ARCH_SUPPORTS=y
#BR2_PACKAGE_LUAJIT_ARCH_SUPPORTS=y
#BR2_PACKAGE_MONO_ARCH_SUPPORTS=y
#BR2_PACKAGE_NODEJS_ARCH_SUPPORTS=y

#BR2_PACKAGE_FDK_AAC_ARCH_SUPPORTS=y
#BR2_PACKAGE_OPENAL_ARCH_SUPPORTS=y
#BR2_PACKAGE_WEBRTC_AUDIO_PROCESSING_ARCH_SUPPORTS=y
#BR2_PACKAGE_BOTAN_ARCH_SUPPORTS=y
#BR2_PACKAGE_LIBGPG_ERROR_ARCH_SUPPORTS=y
#BR2_PACKAGE_LIBGPG_ERROR_SYSCFG="arm-unknown-linux-gnueabi"
#BR2_PACKAGE_PROVIDES_HOST_OPENSSL="host-libopenssl"
#BR2_PACKAGE_MONGODB_ARCH_SUPPORTS=y
#BR2_PACKAGE_JPEG_SIMD_SUPPORT=y
#BR2_PACKAGE_WEBKITGTK_ARCH_SUPPORTS=y
#BR2_PACKAGE_LIBAIO_ARCH_SUPPORTS=y
#BR2_PACKAGE_LIBOPENH264_ARCH_SUPPORTS=y
#BR2_PACKAGE_CANFESTIVAL_ARCH_SUPPORTS=y
#BR2_PACKAGE_CLASSPATH_ARCH_SUPPORTS=y
#BR2_PACKAGE_JEMALLOC_ARCH_SUPPORTS=y
#BR2_PACKAGE_LIBATOMIC_OPS_ARCH_SUPPORTS=y
#BR2_PACKAGE_LIBBSD_ARCH_SUPPORTS=y
#BR2_PACKAGE_LIBNSPR_ARCH_SUPPORT=y
#BR2_PACKAGE_LIBSECCOMP_ARCH_SUPPORTS=y
#BR2_PACKAGE_LIBSIGSEGV_ARCH_SUPPORTS=y
#BR2_PACKAGE_LIBUNWIND_ARCH_SUPPORTS=y
#BR2_PACKAGE_LIBURCU_ARCH_SUPPORTS=y
#BR2_PACKAGE_OPENBLAS_DEFAULT_TARGET="ARMV7"
#BR2_PACKAGE_OPENBLAS_ARCH_SUPPORTS=y
#BR2_PACKAGE_PROTOBUF_ARCH_SUPPORTS=y
#BR2_PACKAGE_QEMU_ARCH_SUPPORTS_TARGET=y
#BR2_PACKAGE_IFUPDOWN_SCRIPTS=y
#BR2_PACKAGE_MONGREL2_LIBC_SUPPORTS=y
#BR2_PACKAGE_XENOMAI_ARCH_SUPPORTS=y
#BR2_PACKAGE_EFIVAR_ARCH_SUPPORTS=y
#BR2_PACKAGE_INITSCRIPTS=y
#BR2_PACKAGE_SYSTEMD_ARCH_SUPPORTS=y
#BR2_PACKAGE_XVISOR_ARCH_SUPPORTS=y
#BR2_PACKAGE_HOST_GO_ARCH_SUPPORTS=y
#BR2_PACKAGE_HOST_GO_CGO_LINKING_SUPPORTS=y
#BR2_PACKAGE_HOST_PATCHELF=y
#BR2_PACKAGE_HOST_TI_CGT_PRU_ARCH_SUPPORTS=y
#BR2_XTENSA_OVERLAY_DIR=""
#BR2_XTENSA_CUSTOM_NAME=""
BR2_PACKAGE_HOST_GENIMAGE=y
BR2_TARGET_ROOTFS_INITRAMFS=y
```
